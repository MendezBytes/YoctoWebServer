## layers/meta-aesd_webapp/conf/layer.conf
```bitbake
# We have a conf and classes directory, add to BBPATH
BBPATH .= ":${LAYERDIR}"

# We have recipes-* directories, add to BBFILES
BBFILES += "${LAYERDIR}/recipes-*/*/*.bb \
            ${LAYERDIR}/recipes-*/*/*.bbappend"

BBFILE_COLLECTIONS += "meta-aesd_webapp"
BBFILE_PATTERN_meta-aesd_webapp = "^${LAYERDIR}/"
BBFILE_PRIORITY_meta-aesd_webapp = "6"

LAYERDEPENDS_meta-aesd_webapp = "core"
LAYERSERIES_COMPAT_meta-aesd_webapp = "kirkstone"
```

## layers/meta-mpl3115a2/conf/layer.conf
```bitbake
# We have a conf and classes directory, add to BBPATH
BBPATH .= ":${LAYERDIR}"

# We have recipes-* directories, add to BBFILES
BBFILES += "${LAYERDIR}/recipes-*/*/*.bb \
            ${LAYERDIR}/recipes-*/*/*.bbappend"

BBFILE_COLLECTIONS += "meta-aesd-mpl3115a2"
BBFILE_PATTERN_meta-aesd-mpl3115a2 = "^${LAYERDIR}/"
BBFILE_PRIORITY_meta-aesd-mpl3115a2 = "6"

LAYERDEPENDS_meta-aesd-mpl3115a2 = "core"
LAYERSERIES_COMPAT_meta-aesd-mpl3115a2 = "kirkstone"
```

## layers/meta-sensor-data-monitoring/conf/layer.conf
```bitbake
# We have a conf and classes directory, add to BBPATH
BBPATH .= ":${LAYERDIR}"

# We have recipes-* directories, add to BBFILES
BBFILES += "${LAYERDIR}/recipes-*/*/*.bb \
            ${LAYERDIR}/recipes-*/*/*.bbappend"

BBFILE_COLLECTIONS += "meta-sensor-data-monitoring"
BBFILE_PATTERN_meta-sensor-data-monitoring= "^${LAYERDIR}/"
BBFILE_PRIORITY_meta-sensor-data-monitoring = "6"

LAYERDEPENDS_meta-sensor-data-monitoring = "core"
LAYERSERIES_COMPAT_meta-sensor-data-monitoring = "kirkstone"
```

## saved_conf/conf/bblayers.conf
```bitbake
# Version of layers configuration, specific to
# each defined distro in the repository.
# Format: ${DISTRO}-<version>
TD_BBLAYERS_CONF_VERSION = "tegrademo-4"

BBPATH = "${TOPDIR}"
BBFILES ?= ""

BBLAYERS ?= " \
  /home/kroosier/AESD/tegra-demo-distro/layers/meta \
  /home/kroosier/AESD/tegra-demo-distro/layers/meta-tegra \
  /home/kroosier/AESD/tegra-demo-distro/layers/meta-tegra/contrib \
  /home/kroosier/AESD/tegra-demo-distro/layers/meta-oe \
  /home/kroosier/AESD/tegra-demo-distro/layers/meta-python \
  /home/kroosier/AESD/tegra-demo-distro/layers/meta-networking \
  /home/kroosier/AESD/tegra-demo-distro/layers/meta-filesystems \
  /home/kroosier/AESD/tegra-demo-distro/layers/meta-webserver \
  /home/kroosier/AESD/tegra-demo-distro/layers/meta-virtualization \
  /home/kroosier/AESD/tegra-demo-distro/layers/meta-tegra-community \
  /home/kroosier/AESD/tegra-demo-distro/layers/meta-tegra-support \
  /home/kroosier/AESD/tegra-demo-distro/layers/meta-demo-ci \
  /home/kroosier/AESD/tegra-demo-distro/layers/meta-tegrademo \
  /home/kroosier/AESD/tegra-demo-distro/layers/meta-aesd-webapp \
  /home/kroosier/AESD/tegra-demo-distro/build/workspace \
  "
```
